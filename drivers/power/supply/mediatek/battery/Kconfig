## drivers/power/supply/mediatek/battery/Kconfig
```kconfig
menuconfig MEDIATEK_BATTERY_SOLUTION
	bool "MediaTek Propritary Configuration for Battery"
	help
	  Check this to enable MediaTek Battery configuration.

config MTK_SMART_BATTERY
	bool "MediaTek Smart Battery Driver"
	help
	  Check this to enable MediaTek smart battery driver.
	  The driver supports charging control flow.
	  It maintais both charger and battery status.
	  It also includes Mediatek gas gauge.

config MTK_GAUGE_VERSION
	int "MediaTek Fuel Gauge version"
	default 20
	help
	  Select MTK Gauge Master version
	  30: Gauge Master 3.0

config MTK_BATTERY_KERNEL_GAUGE
	bool "Use the in-kernel gauge algorithm in normal boot"
	depends on MTK_GAUGE_VERSION = 30
	default n
	help
	  Use the simplified in-kernel fuel gauge algorithm (normally only
	  used in recovery mode) instead of the userspace fuelgauged
	  daemon. Needed when running a non-Android userspace.

config MTK_DISABLE_GAUGE
	bool "disable Gauge Master 3.0"
	default n
	help
	  Set Yes to disable Gauge Master 3.0
	  under new MTK Charger Framework
	  Set No to enable Gauge Master 3.0
	  under new MTK Charger Framework

config MTK_ADDITIONAL_BATTERY_TABLE
	bool "Enable the fifth battery table"
	default y
	help
	  Set Yes to enable the fifth battery table
	  Table number is five.
	  Set No to disable the fifth battery table
	  Table number is four.
```
